## build/conf/bblayers.conf
```bitbake
# POKY_BBLAYERS_CONF_VERSION is increased each time build/conf/bblayers.conf changes incompatibly
POKY_BBLAYERS_CONF_VERSION = "2"

BBPATH = "${TOPDIR}"
BBFILES ?= ""

BBLAYERS ?= " \
  /home/debu/yocto/poky-kirkstone/meta \
  /home/debu/yocto/poky-kirkstone/meta-poky \
  /home/debu/yocto/poky-kirkstone/meta-yocto-bsp \
  /home/debu/yocto/meta-openembedded/meta-oe \
  /home/debu/yocto/meta-openembedded/meta-python \
  /home/debu/yocto/meta-openembedded/meta-networking \
  /home/debu/yocto/meta-ti/meta-ti-bsp \
  /home/debu/yocto/meta-ti/meta-ti-extras \
  /home/debu/yocto/meta-arm/meta-arm \
  /home/debu/yocto/meta-arm/meta-arm-toolchain \
  /home/debu/yocto/poky-kirkstone/meta-custom \
  /home/debu/yocto/poky-kirkstone/meta-ipc \
  /home/debu/yocto/poky-kirkstone/meta-debu-app2 \
  /home/debu/yocto/poky-kirkstone/meta-mytimer \
  /home/debu/yocto/poky-kirkstone/meta-mytimer2 \
  /home/debu/yocto/poky-kirkstone/meta-newlayer \
  /home/debu/yocto/poky-kirkstone/meta-signal \
  /home/debu/yocto/meta-rauc \
  "
```
